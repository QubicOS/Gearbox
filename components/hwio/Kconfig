## components/hwio/Kconfig
```kconfig
menu "STDIO (custom UART backend)"
    config io_LOG_TAG
        string "Лог‑тег для ESP_LOG*"
        default "STDIO"

    config io_UART_PORT
        int "UART‑порт"
        range 0 2
        default 0

    config io_UART_BAUD_RATE
        int "Скорость UART"
        default 115200

    config io_UART_DATA_BITS
        int "Длина слова"
        range 5 8
        default 8

    config io_UART_PARITY
        int "Чётность (0‑нет,1‑чёт,2‑нечёт)"
        range 0 2
        default 0

    config io_UART_STOP_BITS
        int "Стоп‑биты (1 или 2)"
        range 1 2
        default 1

    config io_UART_FLOW_CTRL
        int "HW‑flow‑control (0‑выкл,1‑вкл)"
        range 0 1
        default 0

    config io_UART_BUF_SIZE
        int "Размер буфера UART"
        default 256
endmenu
```

## components/ramdisk/Kconfig
```kconfig
menu "RAM Disk"

config RAMDISK_SIZE
    int "Размер RAM‑диска (байт)"
    range 4096 1048576
    default 65536
    help
        Максимальный объём данных, которые можно
        одновременно хранить в оперативном диске.

config RAMDISK_BASE_PATH
    string "Точка монтирования (Base path)"
    default "/ram"
    help
        Путь, по которому VFS будет доступен в FS‑дереве.

config RAMDISK_MAX_FILES
    int "Максимальное число файлов"
    range 1 64
    default 8
    help
        Сколько разных файлов может существовать
        одновременно (открытых или закрытых).

config RAMDISK_SECTOR_SIZE
    int "Размер «сектора» (минимальный шаг realloc)"
    range 64 4096
    default 512
    help
        При достижении границы буфер расширяется
        кусками указанного размера.

endmenu
```

## components/sdcard/Kconfig
```kconfig
menu "SD Card Configuration"

config SD_MOUNT_POINT
    string "Mount point for SD card"
    default "/mount/sd"
    help
        The path where the SD card will be mounted.

config SD_BUS_WIDTH
    int "SD card bus width"
    range 1 4
    default 1
    help
        Bus width for SD card communication. Set to 1 for 1-bit mode or 4 for 4-bit mode.

config SD_FORMAT_IF_MOUNT_FAILED
    bool "Format SD card if mount fails"
    default y
    help
        If enabled, the SD card will be formatted if mounting fails.

config SD_MAX_OPEN_FILES
    int "Maximum number of open files"
    range 1 10
    default 4
    help
        Maximum number of files that can be open simultaneously.

config SD_ALLOCATION_UNIT_SIZE
    int "Allocation unit size (bytes)"
    default 16384
    help
        Size of the allocation unit for the FAT filesystem.

endmenu
```

## components/uam/Kconfig
```kconfig
menu "esp_uam configuration"
    config UAM_SD_BACKEND_PATH
        string "SD‑card path to users.dat"
        default "/mount/sd/.uam/users.dat"

    config UAM_DEBUG
        bool "Enable esp_uam debug logs"
        default n
endmenu
```
